## deploy/appliance/Config.in
```kconfig
source "$BR2_EXTERNAL_SHUSH_PATH/package/shush/Config.in"
source "$BR2_EXTERNAL_SHUSH_PATH/package/shush-bt-firmware/Config.in"
```

## deploy/appliance/configs/shush_pi3_defconfig
```kconfig
BR2_aarch64=y
BR2_ARM_FPU_VFPV4=y
BR2_TOOLCHAIN_EXTERNAL=y
BR2_TOOLCHAIN_EXTERNAL_BOOTLIN=y
BR2_TOOLCHAIN_EXTERNAL_BOOTLIN_AARCH64_GLIBC_STABLE=y
BR2_GLOBAL_PATCH_DIR="board/raspberrypi/patches"
BR2_DOWNLOAD_FORCE_CHECK_HASHES=y
BR2_SYSTEM_DHCP=""
BR2_ROOTFS_POST_BUILD_SCRIPT="$(BR2_EXTERNAL_SHUSH_PATH)/board/post-build.py"
BR2_ROOTFS_POST_IMAGE_SCRIPT="$(BR2_EXTERNAL_SHUSH_PATH)/board/post-image.py"
BR2_LINUX_KERNEL=y
BR2_LINUX_KERNEL_CUSTOM_TARBALL=y
BR2_LINUX_KERNEL_CUSTOM_TARBALL_LOCATION="$(call github,raspberrypi,linux,21b410140c47ffab5668399f6f143c7d7b935c8b)/linux-21b410140c47ffab5668399f6f143c7d7b935c8b.tar.gz"
BR2_LINUX_KERNEL_DEFCONFIG="bcm2711"
BR2_LINUX_KERNEL_DTS_SUPPORT=y
BR2_LINUX_KERNEL_INTREE_DTS_NAME="broadcom/bcm2710-rpi-3-b broadcom/bcm2710-rpi-3-b-plus broadcom/bcm2710-rpi-cm3"
BR2_LINUX_KERNEL_NEEDS_HOST_OPENSSL=y
BR2_PACKAGE_BUSYBOX_SHOW_OTHERS=y
BR2_PACKAGE_XZ=y
BR2_PACKAGE_RPI_FIRMWARE=y
BR2_PACKAGE_RPI_FIRMWARE_BOOTCODE_BIN=y
BR2_PACKAGE_RPI_FIRMWARE_VARIANT_PI=y
BR2_PACKAGE_RPI_FIRMWARE_CONFIG_FILE="$(BR2_EXTERNAL_SHUSH_PATH)/board/config.txt"
BR2_PACKAGE_KMOD=y
BR2_PACKAGE_KMOD_TOOLS=y
BR2_TARGET_ROOTFS_EXT2=y
BR2_TARGET_ROOTFS_EXT2_4=y
BR2_TARGET_ROOTFS_EXT2_SIZE="3072M"
# BR2_TARGET_ROOTFS_TAR is not set
BR2_PACKAGE_HOST_DOSFSTOOLS=y
BR2_PACKAGE_HOST_GENIMAGE=y
BR2_PACKAGE_HOST_KMOD_XZ=y
BR2_PACKAGE_HOST_MTOOLS=y

BR2_TARGET_GENERIC_HOSTNAME="shush"
BR2_TARGET_GENERIC_ISSUE="Shush alarm appliance"
BR2_INIT_SYSTEMD=y
# BR2_TARGET_GENERIC_REMOUNT_ROOTFS_RW is not set
BR2_INIT_SYSTEMD_VAR_FACTORY=y
# BR2_INIT_SYSTEMD_POPULATE_TMPFILES is not set
# BR2_TARGET_ENABLE_ROOT_LOGIN is not set
# BR2_TARGET_GENERIC_GETTY is not set
BR2_TARGET_LOCALTIME="America/Chicago"
BR2_TARGET_TZ_ZONELIST="northamerica"
BR2_ROOTFS_OVERLAY="$(BR2_EXTERNAL_SHUSH_PATH)/board/rootfs-overlay"
BR2_ROOTFS_USERS_TABLES="$(BR2_EXTERNAL_SHUSH_PATH)/board/users.txt"
BR2_LINUX_KERNEL_CONFIG_FRAGMENT_FILES="$(BR2_EXTERNAL_SHUSH_PATH)/board/linux.fragment"
BR2_PACKAGE_SHUSH=y
BR2_PACKAGE_ALSA_UTILS=y
BR2_PACKAGE_ALSA_UTILS_APLAY=y
# BR2_PACKAGE_ALSA_UTILS_ALSAMIXER is not set
# BR2_PACKAGE_ALSA_UTILS_ALSACONF is not set
# BR2_PACKAGE_ALSA_UTILS_ALSACTL is not set
# BR2_PACKAGE_ALSA_UTILS_AMIXER is not set
# BR2_PACKAGE_ALSA_UTILS_SPEAKER_TEST is not set
BR2_PACKAGE_SYSTEMD_NETWORKD=y
BR2_PACKAGE_SYSTEMD_RESOLVED=y
BR2_PACKAGE_SYSTEMD_TIMEDATED=y
BR2_PACKAGE_SYSTEMD_TIMESYNCD=y
BR2_PACKAGE_WPA_SUPPLICANT=y
BR2_PACKAGE_WPA_SUPPLICANT_NL80211=y
BR2_PACKAGE_LINUX_FIRMWARE=y
BR2_PACKAGE_LINUX_FIRMWARE_BRCM_BCM43XXX=y
BR2_PACKAGE_MOSQUITTO=y
BR2_PACKAGE_MOSQUITTO_CLIENTS=y
# BR2_PACKAGE_MOSQUITTO_BROKER is not set
# BR2_PACKAGE_MOSQUITTO_APPS is not set
BR2_PACKAGE_BLUEZ_ALSA=y
BR2_PACKAGE_BLUEZ5_UTILS_PLUGINS_AUDIO=y
BR2_PACKAGE_PYTHON3=y
BR2_PACKAGE_PYTHON_DBUS_NEXT=y
BR2_PACKAGE_SHUSH_BT_FIRMWARE=y
# BR2_PACKAGE_SYSTEMD_HOSTNAMED is not set
# BR2_PACKAGE_SYSTEMD_PSTORE is not set
# BR2_PACKAGE_SYSTEMD_HWDB is not set
# BR2_PACKAGE_SYSTEMD_MYHOSTNAME is not set
# BR2_PACKAGE_SYSTEMD_VCONSOLE is not set
# BR2_PACKAGE_SYSTEMD_COREDUMP is not set
# BR2_PACKAGE_SYSTEMD_LOGIND is not set
# BR2_PACKAGE_SYSTEMD_RANDOMSEED is not set
BR2_PACKAGE_HOST_QEMU=y
BR2_PACKAGE_HOST_QEMU_LINUX_USER_MODE=y
```

## deploy/appliance/package/shush-bt-firmware/Config.in
```kconfig
config BR2_PACKAGE_SHUSH_BT_FIRMWARE
	bool "Shush Pi 3 B+ Bluetooth firmware"
	help
	  Pinned Raspberry Pi distribution firmware for the BCM4345C0 UART controller.
```

## deploy/appliance/package/shush/Config.in
```kconfig
config BR2_PACKAGE_SHUSH
	bool "shush"
	depends on BR2_PACKAGE_HOST_RUSTC_TARGET_ARCH_SUPPORTS
	depends on BR2_TOOLCHAIN_HAS_THREADS
	depends on !BR2_STATIC_LIBS
	select BR2_PACKAGE_HOST_RUSTC
	select BR2_PACKAGE_ALSA_LIB
	help
	  Audio-only Rust alarm appliance for a Raspberry Pi 3 B+.
	  Builds local repository sources and installs the reading media,
	  pink noise, and prepared voice prompts under /opt/shush.
	  Preparation requires Cargo.lock and network access for vendoring
	  crates on the build host; compilation itself is offline and locked.

comment "shush needs Rust target support and a toolchain with threads and dynamic libraries"
	depends on !BR2_PACKAGE_HOST_RUSTC_TARGET_ARCH_SUPPORTS || !BR2_TOOLCHAIN_HAS_THREADS || BR2_STATIC_LIBS
```
